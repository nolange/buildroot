## package/dbus-broker/Config.in
```kconfig
config BR2_PACKAGE_DBUS_BROKER
	bool "dbus-broker"
	depends on BR2_USE_MMU
	depends on BR2_TOOLCHAIN_HAS_THREADS
	help
	  Linux D-Bus Message Broker.

	  The dbus-broker project is an implementation of a message bus
	  as defined by the D-Bus specification. Its aim is to provide
	  high performance and reliability, while keeping compatibility
	  to the D-Bus reference implementation.

	  It is exclusively written for Linux systems, and makes use of
	  many modern features provided by recent linux kernel releases.

	  https://github.com/bus1/dbus-broker/wiki

if BR2_PACKAGE_DBUS_BROKER
config BR2_PACKAGE_DBUS_BROKER_LAUNCH
	bool "dbus-broker-launch"
	default y
	depends on BR2_INIT_SYSTEMD
	select BR2_PACKAGE_EXPAT
	help
	  Launcher for D-Bus Message Brokers.

	  dbus-broker-launch is a launcher for dbus-broker, spawning and
	  managing a D-Bus Message Bus. The launcher aims to be fully
	  compatible to the D-Bus reference implementation dbus-daemon,
	  supporting the same configuration syntax and runtime environment.
endif

comment "dbus-broker needs a toolchain w/ threads"
	depends on BR2_USE_MMU
	depends on !BR2_TOOLCHAIN_HAS_THREADS
```

## package/libcxx/Config.in
```kconfig
config BR2_PACKAGE_LIBCXX
	bool "libc++"
	depends on BR2_INSTALL_LIBSTDCPP
	help
	  libc++ is a new implementation of the C++ standard library,
	  targeting C++11 (and newer). Part of the LLVM Project.

	  The LLVM Project is a collection of modular and reusable
	  compiler and toolchain technologies.

if BR2_PACKAGE_LIBCXX
choice
	prompt "libc++ abi support"
	default BR2_PACKAGE_LIBCXX_ABI_SUPCXX
	help
	  Select the c++ abi support: libsupc++ (from gcc toolchain)
	  or libc++-abi (from llvm).

config BR2_PACKAGE_LIBCXX_ABI_SUPCXX
	bool "libsupc++"

config BR2_PACKAGE_LIBCXX_ABI_CXXABI
	bool "libc++-abi"

endchoice
endif

comment "libc++ needs a toolchain w/ C++"
	depends on !BR2_INSTALL_LIBSTDCPP
```

## package/tftpd/Config.in
```kconfig
config BR2_PACKAGE_TFTPD
	bool "tftpd"
	# linker issue with pre-6.x toolchains
	depends on !(BR2_nios2 && !BR2_TOOLCHAIN_GCC_AT_LEAST_6)
	depends on BR2_USE_MMU # fork()
	depends on BR2_PACKAGE_BUSYBOX_SHOW_OTHERS
	help
	  HPA's Trivial File Transfer Protocol (tftp) server.

	  https://git.kernel.org/pub/scm/network/tftp/tftp-hpa.git

if BR2_PACKAGE_TFTPD

config BR2_PACKAGE_TFTPD_IPV6
	bool "IPv6 support"
	default y
	help
	  Support IPv6 connections

endif
```
